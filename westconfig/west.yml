## westconfig/west.yml
```yaml
# https://docs.zephyrproject.org/latest/develop/west/manifest.html
manifest:
  remotes:
    - name: xmos
      url-base: git@github.com:xmos

    - name: xalbertoisorna
      url-base: https://github.com/xalbertoisorna/
      
  projects:    
    - name : lib_xassert # fork
      remote : xalbertoisorna
      path: modules/xassert
      submodules: true
      revision: develop     



    
```
